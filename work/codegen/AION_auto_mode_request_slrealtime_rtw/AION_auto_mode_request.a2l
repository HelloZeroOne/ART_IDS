/******************************************************************************
* ASAP2 file: AION_auto_mode_request.a2l
* Code generation for model "AION_auto_mode_request".
* Model version : 1.111
* Simulink Coder version : 10.3 R2021a
* C source code generated on : Tue Jun 21 16:13:30 2022
* Target selection: slrealtime.tlc
* Embedded hardware selection: Intel->x86-64 (Linux 64)
* Code generation objectives: Unspecified
* Validation result: Not run
* (add additional file header information here)
******************************************************************************/ ASAP2_VERSION 1 71
/begin PROJECT ProjectName "Project Comment Goes Here"
/begin HEADER "Header Comments go here" /end HEADER
/begin MODULE ModuleName "Module Comment Goes Here"
/begin IF_DATA XCP
 /begin PROTOCOL_LAYER 0x0100 0x03E8 0x00C8 0x0000 0x0000 0x0000 0x0000 0x0000 0xFC 0x0578 BYTE_ORDER_MSB_LAST ADDRESS_GRANULARITY_BYTE OPTIONAL_CMD ALLOC_ODT_ENTRY OPTIONAL_CMD ALLOC_ODT OPTIONAL_CMD ALLOC_DAQ OPTIONAL_CMD FREE_DAQ OPTIONAL_CMD GET_DAQ_RESOLUTION_INFO OPTIONAL_CMD GET_DAQ_PROCESSOR_INFO OPTIONAL_CMD START_STOP_SYNCH OPTIONAL_CMD START_STOP_DAQ_LIST OPTIONAL_CMD SET_DAQ_LIST_MODE OPTIONAL_CMD WRITE_DAQ OPTIONAL_CMD SET_DAQ_PTR OPTIONAL_CMD GET_CAL_PAGE OPTIONAL_CMD SET_CAL_PAGE OPTIONAL_CMD COPY_CAL_PAGE OPTIONAL_CMD SHORT_DOWNLOAD OPTIONAL_CMD DOWNLOAD_MAX OPTIONAL_CMD DOWNLOAD OPTIONAL_CMD SHORT_UPLOAD OPTIONAL_CMD UPLOAD OPTIONAL_CMD SET_MTA /end PROTOCOL_LAYER
 /begin DAQ DYNAMIC 0x0000 0x0080 0x00 OPTIMISATION_TYPE_DEFAULT ADDRESS_EXTENSION_FREE IDENTIFICATION_FIELD_TYPE_RELATIVE_WORD_ALIGNED GRANULARITY_ODT_ENTRY_SIZE_DAQ_BYTE 0xFF OVERLOAD_INDICATION_PID PRESCALER_SUPPORTED /begin STIM GRANULARITY_ODT_ENTRY_SIZE_STIM_BYTE 0xFF /end STIM /begin TIMESTAMP_SUPPORTED 0x0001 SIZE_DWORD UNIT_1US TIMESTAMP_FIXED /end TIMESTAMP_SUPPORTED /begin EVENT "200 ms" "200 ms" 0x0000 DAQ 0xFF 0x02 0x08 0x00 /end EVENT /end DAQ
 /begin XCP_ON_UDP_IP 0x0100 0x15B3 ADDRESS "192.168.7.1" /end XCP_ON_UDP_IP
/end IF_DATA
/begin MOD_PAR "MOD PAR Comment Goes Here" /end MOD_PAR
/begin MOD_COMMON "Mod Common Comment Here" BYTE_ORDER MSB_LAST ALIGNMENT_BYTE 1 ALIGNMENT_WORD 2 ALIGNMENT_LONG 8 ALIGNMENT_FLOAT32_IEEE 4 ALIGNMENT_FLOAT64_IEEE 8 ALIGNMENT_INT64 4 /end MOD_COMMON
/begin CHARACTERISTIC AION_auto_mode_request_P.BitwiseAND_BitMask "" VALUE 0x00204020 Scalar_ULONG 0 AION_auto_mode_request_CM_uint32 0 2147483646 /end CHARACTERISTIC
/begin CHARACTERISTIC AION_auto_mode_request_P.SPK_Chk_tableData "" CURVE 0x00204028 FixLookup_FLOAT64_IEEE 0 AION_auto_mode_request_CM_double -1.7E+308 1.7E+308
 /begin AXIS_DESCR FIX_AXIS AION_auto_mode_request_B.QlightChannel AION_auto_mode_request_CM_double 5 0.000000 4.000000 FIX_AXIS_PAR_DIST 0 1 5 /end AXIS_DESCR
/end CHARACTERISTIC
/begin MEASUREMENT AION_auto_mode_request_B.BitwiseAND "" ULONG AION_auto_mode_request_CM_uint32 0 0 0 2147483646 ECU_ADDRESS 0x00204630 /end MEASUREMENT
/begin MEASUREMENT AION_auto_mode_request_B.DataTypeConversion1 "" SLONG AION_auto_mode_request_CM_Control_request 0 0 0 3 ECU_ADDRESS 0x00204698 /end MEASUREMENT
/begin MEASUREMENT AION_auto_mode_request_B.DataTypeConversion10 "" UBYTE AION_auto_mode_request_CM_uint8 0 0 0 255 ECU_ADDRESS 0x002046D2 /end MEASUREMENT
/begin MEASUREMENT AION_auto_mode_request_B.DataTypeConversion2 "" UBYTE AION_auto_mode_request_CM_uint8 0 0 0 255 ECU_ADDRESS 0x002046D1 /end MEASUREMENT
/begin MEASUREMENT AION_auto_mode_request_B.DataTypeConversion9 "" SLONG AION_auto_mode_request_CM_Control_request 0 0 0 3 ECU_ADDRESS 0x0020469C /end MEASUREMENT
/begin MEASUREMENT AION_auto_mode_request_B.LatCtrlReq "" FLOAT64_IEEE AION_auto_mode_request_CM_double 0 0 -1.7E+308 1.7E+308 ECU_ADDRESS 0x00204628 /end MEASUREMENT
/begin MEASUREMENT AION_auto_mode_request_B.LngCtrlReq "" FLOAT64_IEEE AION_auto_mode_request_CM_double 0 0 -1.7E+308 1.7E+308 ECU_ADDRESS 0x00204620 /end MEASUREMENT
/begin MEASUREMENT AION_auto_mode_request_B.QlightChannel "" FLOAT64_IEEE AION_auto_mode_request_CM_double 0 0 -1.7E+308 1.7E+308 ECU_ADDRESS 0x00204520 /end MEASUREMENT
/begin MEASUREMENT AION_auto_mode_request_B.QlightChannel_f "" UBYTE AION_auto_mode_request_CM_uint8 0 0 0 255 ECU_ADDRESS 0x002046D3 /end MEASUREMENT
/begin MEASUREMENT AION_auto_mode_request_B.SPK_Chk "" FLOAT64_IEEE AION_auto_mode_request_CM_double 0 0 -1.7E+308 1.7E+308 ECU_ADDRESS 0x00204528 /end MEASUREMENT
/begin MEASUREMENT AION_auto_mode_request_B.get_ABSActiveSt "" UBYTE AION_auto_mode_request_CM_uint8__ 0 0 0 255 ECU_ADDRESS 0x002046C4 /end MEASUREMENT
/begin MEASUREMENT AION_auto_mode_request_B.get_ACCButtInfo "" ULONG AION_auto_mode_request_CM_uint32 0 0 0 2147483646 ECU_ADDRESS 0x00204654 /end MEASUREMENT
/begin MEASUREMENT AION_auto_mode_request_B.get_AccElecECFail "" UBYTE AION_auto_mode_request_CM_uint8__ 0 0 0 255 ECU_ADDRESS 0x002046C8 /end MEASUREMENT
/begin MEASUREMENT AION_auto_mode_request_B.get_AccelerationX "" FLOAT64_IEEE AION_auto_mode_request_CM_double_g 0 0 -1.7E+308 1.7E+308 ECU_ADDRESS 0x002045F0 /end MEASUREMENT
/begin MEASUREMENT AION_auto_mode_request_B.get_AccelerationY "" FLOAT64_IEEE AION_auto_mode_request_CM_double_g 0 0 -1.7E+308 1.7E+308 ECU_ADDRESS 0x002045F8 /end MEASUREMENT
/begin MEASUREMENT AION_auto_mode_request_B.get_AccelerationZ "" FLOAT64_IEEE AION_auto_mode_request_CM_double_g 0 0 -1.7E+308 1.7E+308 ECU_ADDRESS 0x00204600 /end MEASUREMENT
/begin MEASUREMENT AION_auto_mode_request_B.get_ActVehLaltrlAccel "" FLOAT64_IEEE AION_auto_mode_request_CM_double_m_s_2 0 0 -1.7E+308 1.7E+308 ECU_ADDRESS 0x00204578 /end MEASUREMENT
/begin MEASUREMENT AION_auto_mode_request_B.get_ActVehLongAccel "" FLOAT64_IEEE AION_auto_mode_request_CM_double_m_s_2 0 0 -1.7E+308 1.7E+308 ECU_ADDRESS 0x00204580 /end MEASUREMENT
/begin MEASUREMENT AION_auto_mode_request_B.get_ActVehWheelTorq "" ULONG AION_auto_mode_request_CM_uint32_Nm 0 0 0 2147483646 ECU_ADDRESS 0x00204648 /end MEASUREMENT
/begin MEASUREMENT AION_auto_mode_request_B.get_Altitude "" FLOAT64_IEEE AION_auto_mode_request_CM_double_m 0 0 -1.7E+308 1.7E+308 ECU_ADDRESS 0x00204618 /end MEASUREMENT
/begin MEASUREMENT AION_auto_mode_request_B.get_AngleSpeedX "" FLOAT64_IEEE AION_auto_mode_request_CM_double___s 0 0 -1.7E+308 1.7E+308 ECU_ADDRESS 0x002045D8 /end MEASUREMENT
/begin MEASUREMENT AION_auto_mode_request_B.get_AngleSpeedY "" FLOAT64_IEEE AION_auto_mode_request_CM_double___s 0 0 -1.7E+308 1.7E+308 ECU_ADDRESS 0x002045E0 /end MEASUREMENT
/begin MEASUREMENT AION_auto_mode_request_B.get_AngleSpeedZ "" FLOAT64_IEEE AION_auto_mode_request_CM_double___s 0 0 -1.7E+308 1.7E+308 ECU_ADDRESS 0x002045E8 /end MEASUREMENT
/begin MEASUREMENT AION_auto_mode_request_B.get_BrkPedalSt "" UBYTE AION_auto_mode_request_CM_uint8 0 0 0 255 ECU_ADDRESS 0x002046C9 /end MEASUREMENT
/begin MEASUREMENT AION_auto_mode_request_B.get_CrntGearLvl "" SLONG AION_auto_mode_request_CM_Gear_status 0 0 0 4 ECU_ADDRESS 0x00204680 /end MEASUREMENT
/begin MEASUREMENT AION_auto_mode_request_B.get_CrntGearLvlVD "" UBYTE AION_auto_mode_request_CM_uint8 0 0 0 255 ECU_ADDRESS 0x002046C7 /end MEASUREMENT
/begin MEASUREMENT AION_auto_mode_request_B.get_CtrlAvailable "" SLONG AION_auto_mode_request_CM_Available_status 0 0 0 1 ECU_ADDRESS 0x002046A4 /end MEASUREMENT
/begin MEASUREMENT AION_auto_mode_request_B.get_DriverSeatBeltSt "" UBYTE AION_auto_mode_request_CM_uint8 0 0 0 255 ECU_ADDRESS 0x002046CC /end MEASUREMENT
/begin MEASUREMENT AION_auto_mode_request_B.get_GPSTime "" FLOAT64_IEEE AION_auto_mode_request_CM_double_s 0 0 -1.7E+308 1.7E+308 ECU_ADDRESS 0x002045B8 /end MEASUREMENT
/begin MEASUREMENT AION_auto_mode_request_B.get_GPSWeek "" FLOAT64_IEEE AION_auto_mode_request_CM_double 0 0 -1.7E+308 1.7E+308 ECU_ADDRESS 0x002045B0 /end MEASUREMENT
/begin MEASUREMENT AION_auto_mode_request_B.get_GasPedalActPst "" FLOAT64_IEEE AION_auto_mode_request_CM_double 0 0 -1.7E+308 1.7E+308 ECU_ADDRESS 0x00204588 /end MEASUREMENT
/begin MEASUREMENT AION_auto_mode_request_B.get_GearLeverIntv "" UBYTE AION_auto_mode_request_CM_uint8 0 0 0 255 ECU_ADDRESS 0x002046C6 /end MEASUREMENT
/begin MEASUREMENT AION_auto_mode_request_B.get_HazardLampSt "" SLONG AION_auto_mode_request_CM_Active_status 0 0 0 1 ECU_ADDRESS 0x002046A8 /end MEASUREMENT
/begin MEASUREMENT AION_auto_mode_request_B.get_Heading "" FLOAT64_IEEE AION_auto_mode_request_CM_double__ 0 0 -1.7E+308 1.7E+308 ECU_ADDRESS 0x002045C0 /end MEASUREMENT
/begin MEASUREMENT AION_auto_mode_request_B.get_HighBeamSt "" SLONG AION_auto_mode_request_CM_Active_status 0 0 0 1 ECU_ADDRESS 0x002046AC /end MEASUREMENT
/begin MEASUREMENT AION_auto_mode_request_B.get_HornSt "" SLONG AION_auto_mode_request_CM_Active_status 0 0 0 1 ECU_ADDRESS 0x002046B0 /end MEASUREMENT
/begin MEASUREMENT AION_auto_mode_request_B.get_IMUWorkStatus "" SLONG AION_auto_mode_request_CM_IMU_Status 0 0 0 91 ECU_ADDRESS 0x0020467C /end MEASUREMENT
/begin MEASUREMENT AION_auto_mode_request_B.get_KeySt "" UBYTE AION_auto_mode_request_CM_uint8 0 0 0 255 ECU_ADDRESS 0x002046D0 /end MEASUREMENT
/begin MEASUREMENT AION_auto_mode_request_B.get_LatAutoCheckReport "" ULONG AION_auto_mode_request_CM_uint32 0 0 0 2147483646 ECU_ADDRESS 0x00204658 /end MEASUREMENT
/begin MEASUREMENT AION_auto_mode_request_B.get_LatCtrlMode "" SLONG AION_auto_mode_request_CM_Control_status 0 0 0 3 ECU_ADDRESS 0x00204690 /end MEASUREMENT
/begin MEASUREMENT AION_auto_mode_request_B.get_LatQuitReport "" ULONG AION_auto_mode_request_CM_uint32 0 0 0 2147483646 ECU_ADDRESS 0x0020465C /end MEASUREMENT
/begin MEASUREMENT AION_auto_mode_request_B.get_Latitude "" FLOAT64_IEEE AION_auto_mode_request_CM_double__ 0 0 -1.7E+308 1.7E+308 ECU_ADDRESS 0x00204608 /end MEASUREMENT
/begin MEASUREMENT AION_auto_mode_request_B.get_LeftTurnLampSt "" SLONG AION_auto_mode_request_CM_Active_status 0 0 0 1 ECU_ADDRESS 0x002046B4 /end MEASUREMENT
/begin MEASUREMENT AION_auto_mode_request_B.get_LngAutoCheckIReport "" ULONG AION_auto_mode_request_CM_uint32 0 0 0 2147483646 ECU_ADDRESS 0x00204660 /end MEASUREMENT
/begin MEASUREMENT AION_auto_mode_request_B.get_LngCtrlMode "" SLONG AION_auto_mode_request_CM_Control_status 0 0 0 3 ECU_ADDRESS 0x00204694 /end MEASUREMENT
/begin MEASUREMENT AION_auto_mode_request_B.get_LngQuitReport "" ULONG AION_auto_mode_request_CM_uint32 0 0 0 2147483646 ECU_ADDRESS 0x00204664 /end MEASUREMENT
/begin MEASUREMENT AION_auto_mode_request_B.get_Longitude "" FLOAT64_IEEE AION_auto_mode_request_CM_double__ 0 0 -1.7E+308 1.7E+308 ECU_ADDRESS 0x00204610 /end MEASUREMENT
/begin MEASUREMENT AION_auto_mode_request_B.get_LowBeamSt "" SLONG AION_auto_mode_request_CM_Active_status 0 0 0 1 ECU_ADDRESS 0x002046B8 /end MEASUREMENT
/begin MEASUREMENT AION_auto_mode_request_B.get_Pitch "" FLOAT64_IEEE AION_auto_mode_request_CM_double__ 0 0 -1.7E+308 1.7E+308 ECU_ADDRESS 0x002045C8 /end MEASUREMENT
/begin MEASUREMENT AION_auto_mode_request_B.get_PsngrSeatBeltSt "" UBYTE AION_auto_mode_request_CM_uint8 0 0 0 255 ECU_ADDRESS 0x002046CD /end MEASUREMENT
/begin MEASUREMENT AION_auto_mode_request_B.get_RightTurnLampSt "" SLONG AION_auto_mode_request_CM_Active_status 0 0 0 1 ECU_ADDRESS 0x002046BC /end MEASUREMENT
/begin MEASUREMENT AION_auto_mode_request_B.get_Roll "" FLOAT64_IEEE AION_auto_mode_request_CM_double__ 0 0 -1.7E+308 1.7E+308 ECU_ADDRESS 0x002045D0 /end MEASUREMENT
/begin MEASUREMENT AION_auto_mode_request_B.get_SteeringAngle "" FLOAT64_IEEE AION_auto_mode_request_CM_double_deg 0 0 -1.7E+308 1.7E+308 ECU_ADDRESS 0x00204598 /end MEASUREMENT
/begin MEASUREMENT AION_auto_mode_request_B.get_SteeringAngleSpd "" ULONG AION_auto_mode_request_CM_uint32_deg_sec 0 0 0 2147483646 ECU_ADDRESS 0x00204668 /end MEASUREMENT
/begin MEASUREMENT AION_auto_mode_request_B.get_SteeringAngleSpdVD "" UBYTE AION_auto_mode_request_CM_uint8 0 0 0 255 ECU_ADDRESS 0x002046CE /end MEASUREMENT
/begin MEASUREMENT AION_auto_mode_request_B.get_SteeringAngleVD "" UBYTE AION_auto_mode_request_CM_uint8 0 0 0 255 ECU_ADDRESS 0x002046CF /end MEASUREMENT
/begin MEASUREMENT AION_auto_mode_request_B.get_StrngWhlIntv "" UBYTE AION_auto_mode_request_CM_uint8 0 0 0 255 ECU_ADDRESS 0x002046CA /end MEASUREMENT
/begin MEASUREMENT AION_auto_mode_request_B.get_StrngWhlTorq "" FLOAT64_IEEE AION_auto_mode_request_CM_double_Nm 0 0 -1.7E+308 1.7E+308 ECU_ADDRESS 0x002045A0 /end MEASUREMENT
/begin MEASUREMENT AION_auto_mode_request_B.get_SysSt "" UBYTE AION_auto_mode_request_CM_uint8 0 0 0 255 ECU_ADDRESS 0x002046CB /end MEASUREMENT
/begin MEASUREMENT AION_auto_mode_request_B.get_VehDrvMod "" SLONG AION_auto_mode_request_CM_Drive_status__ 0 0 0 5 ECU_ADDRESS 0x0020468C /end MEASUREMENT
/begin MEASUREMENT AION_auto_mode_request_B.get_VehRdySt "" SLONG AION_auto_mode_request_CM_Ready_status__ 0 0 0 1 ECU_ADDRESS 0x00204674 /end MEASUREMENT
/begin MEASUREMENT AION_auto_mode_request_B.get_VehRng "" ULONG AION_auto_mode_request_CM_uint32_km 0 0 0 2147483646 ECU_ADDRESS 0x0020464C /end MEASUREMENT
/begin MEASUREMENT AION_auto_mode_request_B.get_VehSpd "" FLOAT64_IEEE AION_auto_mode_request_CM_double_km_h 0 0 -1.7E+308 1.7E+308 ECU_ADDRESS 0x00204560 /end MEASUREMENT
/begin MEASUREMENT AION_auto_mode_request_B.get_VehSpdVD "" UBYTE AION_auto_mode_request_CM_uint8__ 0 0 0 255 ECU_ADDRESS 0x002046C5 /end MEASUREMENT
/begin MEASUREMENT AION_auto_mode_request_B.get_VehWheelTorqMax "" ULONG AION_auto_mode_request_CM_uint32_Nm 0 0 0 2147483646 ECU_ADDRESS 0x00204650 /end MEASUREMENT
/begin MEASUREMENT AION_auto_mode_request_B.get_YawRate "" FLOAT64_IEEE AION_auto_mode_request_CM_double_rad_s 0 0 -1.7E+308 1.7E+308 ECU_ADDRESS 0x00204568 /end MEASUREMENT
/begin MEASUREMENT AION_auto_mode_request_B.set_AutoTrqWhlReq "" FLOAT64_IEEE AION_auto_mode_request_CM_double 0 0 -1.7E+308 1.7E+308 ECU_ADDRESS 0x00204590 /end MEASUREMENT
/begin MEASUREMENT AION_auto_mode_request_B.set_BeamReq "" SLONG AION_auto_mode_request_CM_Beam_request__ 0 0 0 3 ECU_ADDRESS 0x002046A0 /end MEASUREMENT
/begin MEASUREMENT AION_auto_mode_request_B.set_BodyCtrlReq "" SLONG AION_auto_mode_request_CM_Enable_request__ 0 0 0 1 ECU_ADDRESS 0x00204688 /end MEASUREMENT
/begin MEASUREMENT AION_auto_mode_request_B.set_BrakeReq "" FLOAT64_IEEE AION_auto_mode_request_CM_double 0 0 -1.7E+308 1.7E+308 ECU_ADDRESS 0x002045A8 /end MEASUREMENT
/begin MEASUREMENT AION_auto_mode_request_B.set_Checksum1 "" ULONG AION_auto_mode_request_CM_uint32 0 0 0 2147483646 ECU_ADDRESS 0x0020466C /end MEASUREMENT
/begin MEASUREMENT AION_auto_mode_request_B.set_Checksum2 "" ULONG AION_auto_mode_request_CM_uint32 0 0 0 2147483646 ECU_ADDRESS 0x00204638 /end MEASUREMENT
/begin MEASUREMENT AION_auto_mode_request_B.set_Checksum3 "" ULONG AION_auto_mode_request_CM_uint32__ 0 0 0 2147483646 ECU_ADDRESS 0x00204640 /end MEASUREMENT
/begin MEASUREMENT AION_auto_mode_request_B.set_Etx "" FLOAT64_IEEE AION_auto_mode_request_CM_double 0 0 -1.7E+308 1.7E+308 ECU_ADDRESS 0x00204558 /end MEASUREMENT
/begin MEASUREMENT AION_auto_mode_request_B.set_FunctionCode "" FLOAT64_IEEE AION_auto_mode_request_CM_double 0 0 -1.7E+308 1.7E+308 ECU_ADDRESS 0x00204540 /end MEASUREMENT
/begin MEASUREMENT AION_auto_mode_request_B.set_GearLvlReq "" SLONG AION_auto_mode_request_CM_Gear_request 0 0 0 7 ECU_ADDRESS 0x00204684 /end MEASUREMENT
/begin MEASUREMENT AION_auto_mode_request_B.set_GearLvlReqVD "" SLONG AION_auto_mode_request_CM_Validation_status 0 0 0 1 ECU_ADDRESS 0x00204670 /end MEASUREMENT
/begin MEASUREMENT AION_auto_mode_request_B.set_HornRingReq "" SLONG AION_auto_mode_request_CM_Active_request__ 0 0 0 1 ECU_ADDRESS 0x002046C0 /end MEASUREMENT
/begin MEASUREMENT AION_auto_mode_request_B.set_MsgCounter1 "" ULONG AION_auto_mode_request_CM_uint32 0 0 0 2147483646 ECU_ADDRESS 0x00204634 /end MEASUREMENT
/begin MEASUREMENT AION_auto_mode_request_B.set_MsgCounter2 "" ULONG AION_auto_mode_request_CM_uint32 0 0 0 2147483646 ECU_ADDRESS 0x0020463C /end MEASUREMENT
/begin MEASUREMENT AION_auto_mode_request_B.set_MsgCounter3 "" ULONG AION_auto_mode_request_CM_uint32__ 0 0 0 2147483646 ECU_ADDRESS 0x00204644 /end MEASUREMENT
/begin MEASUREMENT AION_auto_mode_request_B.set_Parameter "" FLOAT64_IEEE AION_auto_mode_request_CM_double 0 0 -1.7E+308 1.7E+308 ECU_ADDRESS 0x00204550 /end MEASUREMENT
/begin MEASUREMENT AION_auto_mode_request_B.set_SteerAngReq "" FLOAT64_IEEE AION_auto_mode_request_CM_double 0 0 -1.7E+308 1.7E+308 ECU_ADDRESS 0x00204538 /end MEASUREMENT
/begin MEASUREMENT AION_auto_mode_request_B.set_SteerWhlTorqReq "" FLOAT64_IEEE AION_auto_mode_request_CM_double 0 0 -1.7E+308 1.7E+308 ECU_ADDRESS 0x00204570 /end MEASUREMENT
/begin MEASUREMENT AION_auto_mode_request_B.set_Stx "" FLOAT64_IEEE AION_auto_mode_request_CM_double 0 0 -1.7E+308 1.7E+308 ECU_ADDRESS 0x00204530 /end MEASUREMENT
/begin MEASUREMENT AION_auto_mode_request_B.set_TurnLightReq "" SLONG AION_auto_mode_request_CM_Light_request__ 0 0 0 3 ECU_ADDRESS 0x00204678 /end MEASUREMENT
/begin MEASUREMENT AION_auto_mode_request_B.set_VolumeCode "" FLOAT64_IEEE AION_auto_mode_request_CM_double 0 0 -1.7E+308 1.7E+308 ECU_ADDRESS 0x00204548 /end MEASUREMENT
/begin MEASUREMENT AION_auto_mode_request_DW.HoldFlag "" FLOAT64_IEEE AION_auto_mode_request_CM_double 0 0 -1.7E+308 1.7E+308 ECU_ADDRESS 0x002044E8 /end MEASUREMENT
/begin MEASUREMENT AION_auto_mode_request_DW.flag "" FLOAT64_IEEE AION_auto_mode_request_CM_double 0 0 -1.7E+308 1.7E+308 ECU_ADDRESS 0x002044E0 /end MEASUREMENT
/begin MEASUREMENT AION_auto_mode_request_DW.is_active_c2_AION_auto_mode_request "" UBYTE AION_auto_mode_request_CM_uint8 0 0 0 255 ECU_ADDRESS 0x00204510 /end MEASUREMENT
/begin MEASUREMENT AION_auto_mode_request_DW.is_active_c3_AION_auto_mode_request "" UBYTE AION_auto_mode_request_CM_uint8 0 0 0 255 ECU_ADDRESS 0x00204511 /end MEASUREMENT
/begin MEASUREMENT AION_auto_mode_request_DW.is_c2_AION_auto_mode_request "" ULONG AION_auto_mode_request_CM_uint32 0 0 0 2147483646 ECU_ADDRESS 0x00204508 /end MEASUREMENT
/begin MEASUREMENT AION_auto_mode_request_DW.is_c3_AION_auto_mode_request "" ULONG AION_auto_mode_request_CM_uint32 0 0 0 2147483646 ECU_ADDRESS 0x0020450C /end MEASUREMENT
/begin MEASUREMENT AION_auto_mode_request_DW.sfEvent "" SLONG AION_auto_mode_request_CM_int32 0 0 -2147483648 2147483647 ECU_ADDRESS 0x00204500 /end MEASUREMENT
/begin MEASUREMENT AION_auto_mode_request_DW.sfEvent_b "" SLONG AION_auto_mode_request_CM_int32 0 0 -2147483648 2147483647 ECU_ADDRESS 0x00204504 /end MEASUREMENT
/begin MEASUREMENT AION_auto_mode_request_U.InBus_get_BCM_info_get_CtrlAvailable "" SLONG AION_auto_mode_request_CM_Available_status 0 0 0 1 ECU_ADDRESS 0x00204438 /end MEASUREMENT
/begin MEASUREMENT AION_auto_mode_request_U.InBus_get_BCM_info_get_HazardLampSt "" SLONG AION_auto_mode_request_CM_Active_status 0 0 0 1 ECU_ADDRESS 0x0020443C /end MEASUREMENT
/begin MEASUREMENT AION_auto_mode_request_U.InBus_get_BCM_info_get_HighBeamSt "" SLONG AION_auto_mode_request_CM_Active_status 0 0 0 1 ECU_ADDRESS 0x00204440 /end MEASUREMENT
/begin MEASUREMENT AION_auto_mode_request_U.InBus_get_BCM_info_get_HornSt "" SLONG AION_auto_mode_request_CM_Active_status 0 0 0 1 ECU_ADDRESS 0x00204444 /end MEASUREMENT
/begin MEASUREMENT AION_auto_mode_request_U.InBus_get_BCM_info_get_KeySt "" UBYTE AION_auto_mode_request_CM_uint8 0 0 0 3 ECU_ADDRESS 0x00204448 /end MEASUREMENT
/begin MEASUREMENT AION_auto_mode_request_U.InBus_get_BCM_info_get_LeftTurnLampSt "" SLONG AION_auto_mode_request_CM_Active_status 0 0 0 1 ECU_ADDRESS 0x0020444C /end MEASUREMENT
/begin MEASUREMENT AION_auto_mode_request_U.InBus_get_BCM_info_get_LowBeamSt "" SLONG AION_auto_mode_request_CM_Active_status 0 0 0 1 ECU_ADDRESS 0x00204450 /end MEASUREMENT
/begin MEASUREMENT AION_auto_mode_request_U.InBus_get_BCM_info_get_RightTurnLampSt "" SLONG AION_auto_mode_request_CM_Active_status 0 0 0 1 ECU_ADDRESS 0x00204454 /end MEASUREMENT
/begin MEASUREMENT AION_auto_mode_request_U.InBus_get_BCS_info_get_ABSActiveSt "" UBYTE AION_auto_mode_request_CM_uint8__ 0 0 0 1 ECU_ADDRESS 0x00204398 /end MEASUREMENT
/begin MEASUREMENT AION_auto_mode_request_U.InBus_get_BCS_info_get_ActVehLaltrlAccel "" FLOAT64_IEEE AION_auto_mode_request_CM_double_m_s_2 0 0 -21.593 21.593 ECU_ADDRESS 0x002043B8 /end MEASUREMENT
/begin MEASUREMENT AION_auto_mode_request_U.InBus_get_BCS_info_get_ActVehLongAccel "" FLOAT64_IEEE AION_auto_mode_request_CM_double_m_s_2 0 0 -21.593 21.593 ECU_ADDRESS 0x002043C0 /end MEASUREMENT
/begin MEASUREMENT AION_auto_mode_request_U.InBus_get_BCS_info_get_VehSpd "" FLOAT64_IEEE AION_auto_mode_request_CM_double_km_h 0 0 0 240 ECU_ADDRESS 0x002043A0 /end MEASUREMENT
/begin MEASUREMENT AION_auto_mode_request_U.InBus_get_BCS_info_get_VehSpdVD "" UBYTE AION_auto_mode_request_CM_uint8__ 0 0 0 1 ECU_ADDRESS 0x002043A8 /end MEASUREMENT
/begin MEASUREMENT AION_auto_mode_request_U.InBus_get_BCS_info_get_YawRate "" FLOAT64_IEEE AION_auto_mode_request_CM_double_rad_s 0 0 -2.0943 1.9047234375 ECU_ADDRESS 0x002043B0 /end MEASUREMENT
/begin MEASUREMENT AION_auto_mode_request_U.InBus_get_EPB_info_get_SysSt "" UBYTE AION_auto_mode_request_CM_uint8 0 0 0 7 ECU_ADDRESS 0x00204419 /end MEASUREMENT
/begin MEASUREMENT AION_auto_mode_request_U.InBus_get_EPS_info_get_SteeringAngle "" FLOAT64_IEEE AION_auto_mode_request_CM_double_deg 0 0 -780 779.9 ECU_ADDRESS 0x00204420 /end MEASUREMENT
/begin MEASUREMENT AION_auto_mode_request_U.InBus_get_EPS_info_get_SteeringAngleSpd "" ULONG AION_auto_mode_request_CM_uint32_deg_sec 0 0 0 1016 ECU_ADDRESS 0x00204428 /end MEASUREMENT
/begin MEASUREMENT AION_auto_mode_request_U.InBus_get_EPS_info_get_SteeringAngleSpdVD "" UBYTE AION_auto_mode_request_CM_uint8 0 0 0 1 ECU_ADDRESS 0x0020442C /end MEASUREMENT
/begin MEASUREMENT AION_auto_mode_request_U.InBus_get_EPS_info_get_SteeringAngleVD "" UBYTE AION_auto_mode_request_CM_uint8 0 0 0 1 ECU_ADDRESS 0x0020442D /end MEASUREMENT
/begin MEASUREMENT AION_auto_mode_request_U.InBus_get_EPS_info_get_StrngWhlTorq "" FLOAT64_IEEE AION_auto_mode_request_CM_double_Nm 0 0 -12.5 12.5 ECU_ADDRESS 0x00204430 /end MEASUREMENT
/begin MEASUREMENT AION_auto_mode_request_U.InBus_get_IMU_info_get_AccelerationX "" FLOAT64_IEEE AION_auto_mode_request_CM_double_g 0 0 -10 10 ECU_ADDRESS 0x002044A0 /end MEASUREMENT
/begin MEASUREMENT AION_auto_mode_request_U.InBus_get_IMU_info_get_AccelerationY "" FLOAT64_IEEE AION_auto_mode_request_CM_double_g 0 0 -10 10 ECU_ADDRESS 0x002044A8 /end MEASUREMENT
/begin MEASUREMENT AION_auto_mode_request_U.InBus_get_IMU_info_get_AccelerationZ "" FLOAT64_IEEE AION_auto_mode_request_CM_double_g 0 0 -10 10 ECU_ADDRESS 0x002044B0 /end MEASUREMENT
/begin MEASUREMENT AION_auto_mode_request_U.InBus_get_IMU_info_get_Altitude "" FLOAT64_IEEE AION_auto_mode_request_CM_double_m 0 0 -200 8000 ECU_ADDRESS 0x002044C8 /end MEASUREMENT
/begin MEASUREMENT AION_auto_mode_request_U.InBus_get_IMU_info_get_AngleSpeedX "" FLOAT64_IEEE AION_auto_mode_request_CM_double___s 0 0 -360 360 ECU_ADDRESS 0x00204488 /end MEASUREMENT
/begin MEASUREMENT AION_auto_mode_request_U.InBus_get_IMU_info_get_AngleSpeedY "" FLOAT64_IEEE AION_auto_mode_request_CM_double___s 0 0 -360 360 ECU_ADDRESS 0x00204490 /end MEASUREMENT
/begin MEASUREMENT AION_auto_mode_request_U.InBus_get_IMU_info_get_AngleSpeedZ "" FLOAT64_IEEE AION_auto_mode_request_CM_double___s 0 0 -360 360 ECU_ADDRESS 0x00204498 /end MEASUREMENT
/begin MEASUREMENT AION_auto_mode_request_U.InBus_get_IMU_info_get_GPSTime "" FLOAT64_IEEE AION_auto_mode_request_CM_double_s 0 0 0 [] ECU_ADDRESS 0x00204460 /end MEASUREMENT
/begin MEASUREMENT AION_auto_mode_request_U.InBus_get_IMU_info_get_GPSWeek "" FLOAT64_IEEE AION_auto_mode_request_CM_double 0 0 -1.7E+308 1.7E+308 ECU_ADDRESS 0x00204458 /end MEASUREMENT
/begin MEASUREMENT AION_auto_mode_request_U.InBus_get_IMU_info_get_Heading "" FLOAT64_IEEE AION_auto_mode_request_CM_double__ 0 0 0 359.99 ECU_ADDRESS 0x00204468 /end MEASUREMENT
/begin MEASUREMENT AION_auto_mode_request_U.InBus_get_IMU_info_get_IMUWorkStatus "" SLONG AION_auto_mode_request_CM_IMU_Status 0 0 0 91 ECU_ADDRESS 0x00204480 /end MEASUREMENT
/begin MEASUREMENT AION_auto_mode_request_U.InBus_get_IMU_info_get_Latitude "" FLOAT64_IEEE AION_auto_mode_request_CM_double__ 0 0 -90 90 ECU_ADDRESS 0x002044B8 /end MEASUREMENT
/begin MEASUREMENT AION_auto_mode_request_U.InBus_get_IMU_info_get_Longitude "" FLOAT64_IEEE AION_auto_mode_request_CM_double__ 0 0 -180 180 ECU_ADDRESS 0x002044C0 /end MEASUREMENT
/begin MEASUREMENT AION_auto_mode_request_U.InBus_get_IMU_info_get_Pitch "" FLOAT64_IEEE AION_auto_mode_request_CM_double__ 0 0 -90 90 ECU_ADDRESS 0x00204470 /end MEASUREMENT
/begin MEASUREMENT AION_auto_mode_request_U.InBus_get_IMU_info_get_Roll "" FLOAT64_IEEE AION_auto_mode_request_CM_double__ 0 0 -180 180 ECU_ADDRESS 0x00204478 /end MEASUREMENT
/begin MEASUREMENT AION_auto_mode_request_U.InBus_get_SCU_info_get_LatAutoCheckReport "" ULONG AION_auto_mode_request_CM_uint32 0 0 0 15 ECU_ADDRESS 0x00204400 /end MEASUREMENT
/begin MEASUREMENT AION_auto_mode_request_U.InBus_get_SCU_info_get_LatCtrlMode "" SLONG AION_auto_mode_request_CM_Control_status 0 0 0 3 ECU_ADDRESS 0x00204404 /end MEASUREMENT
/begin MEASUREMENT AION_auto_mode_request_U.InBus_get_SCU_info_get_LatQuitReport "" ULONG AION_auto_mode_request_CM_uint32 0 0 0 255 ECU_ADDRESS 0x00204408 /end MEASUREMENT
/begin MEASUREMENT AION_auto_mode_request_U.InBus_get_SCU_info_get_LngAutoCheckIReport "" ULONG AION_auto_mode_request_CM_uint32 0 0 0 65535 ECU_ADDRESS 0x0020440C /end MEASUREMENT
/begin MEASUREMENT AION_auto_mode_request_U.InBus_get_SCU_info_get_LngCtrlMode "" SLONG AION_auto_mode_request_CM_Control_status 0 0 0 3 ECU_ADDRESS 0x00204410 /end MEASUREMENT
/begin MEASUREMENT AION_auto_mode_request_U.InBus_get_SCU_info_get_LngQuitReport "" ULONG AION_auto_mode_request_CM_uint32 0 0 0 65535 ECU_ADDRESS 0x00204414 /end MEASUREMENT
/begin MEASUREMENT AION_auto_mode_request_U.InBus_get_SCU_info_get_StrngWhlIntv "" UBYTE AION_auto_mode_request_CM_uint8 0 0 0 1 ECU_ADDRESS 0x00204418 /end MEASUREMENT
/begin MEASUREMENT AION_auto_mode_request_U.InBus_get_SRS_info_get_DriverSeatBeltSt "" UBYTE AION_auto_mode_request_CM_uint8 0 0 0 3 ECU_ADDRESS 0x0020441A /end MEASUREMENT
/begin MEASUREMENT AION_auto_mode_request_U.InBus_get_SRS_info_get_PsngrSeatBeltSt "" UBYTE AION_auto_mode_request_CM_uint8 0 0 0 3 ECU_ADDRESS 0x0020441B /end MEASUREMENT
/begin MEASUREMENT AION_auto_mode_request_U.InBus_get_VCU_info_get_ACCButtInfo "" ULONG AION_auto_mode_request_CM_uint32 0 0 0 255 ECU_ADDRESS 0x002043FC /end MEASUREMENT
/begin MEASUREMENT AION_auto_mode_request_U.InBus_get_VCU_info_get_AccElecECFail "" UBYTE AION_auto_mode_request_CM_uint8__ 0 0 0 1 ECU_ADDRESS 0x002043F0 /end MEASUREMENT
/begin MEASUREMENT AION_auto_mode_request_U.InBus_get_VCU_info_get_ActVehWheelTorq "" ULONG AION_auto_mode_request_CM_uint32_Nm 0 0 0 10000 ECU_ADDRESS 0x002043C8 /end MEASUREMENT
/begin MEASUREMENT AION_auto_mode_request_U.InBus_get_VCU_info_get_BrkPedalSt "" UBYTE AION_auto_mode_request_CM_uint8 0 0 0 1 ECU_ADDRESS 0x002043F8 /end MEASUREMENT
/begin MEASUREMENT AION_auto_mode_request_U.InBus_get_VCU_info_get_CrntGearLvl "" SLONG AION_auto_mode_request_CM_Gear_status 0 0 0 4 ECU_ADDRESS 0x002043DC /end MEASUREMENT
/begin MEASUREMENT AION_auto_mode_request_U.InBus_get_VCU_info_get_CrntGearLvlVD "" UBYTE AION_auto_mode_request_CM_uint8 0 0 0 1 ECU_ADDRESS 0x002043E0 /end MEASUREMENT
/begin MEASUREMENT AION_auto_mode_request_U.InBus_get_VCU_info_get_GasPedalActPst "" FLOAT64_IEEE AION_auto_mode_request_CM_double 0 0 0 100 ECU_ADDRESS 0x002043E8 /end MEASUREMENT
/begin MEASUREMENT AION_auto_mode_request_U.InBus_get_VCU_info_get_GearLeverIntv "" UBYTE AION_auto_mode_request_CM_uint8 0 0 0 1 ECU_ADDRESS 0x002043CC /end MEASUREMENT
/begin MEASUREMENT AION_auto_mode_request_U.InBus_get_VCU_info_get_VehDrvMod "" SLONG AION_auto_mode_request_CM_Drive_status__ 0 0 0 5 ECU_ADDRESS 0x002043D0 /end MEASUREMENT
/begin MEASUREMENT AION_auto_mode_request_U.InBus_get_VCU_info_get_VehRdySt "" SLONG AION_auto_mode_request_CM_Ready_status__ 0 0 0 1 ECU_ADDRESS 0x002043D4 /end MEASUREMENT
/begin MEASUREMENT AION_auto_mode_request_U.InBus_get_VCU_info_get_VehRng "" ULONG AION_auto_mode_request_CM_uint32_km 0 0 0 1000 ECU_ADDRESS 0x002043D8 /end MEASUREMENT
/begin MEASUREMENT AION_auto_mode_request_U.InBus_get_VCU_info_get_VehWheelTorqMax "" ULONG AION_auto_mode_request_CM_uint32_Nm 0 0 0 10000 ECU_ADDRESS 0x002043F4 /end MEASUREMENT
/begin MEASUREMENT AION_auto_mode_request_U.InBus_set_ADCU_info_set_BeamReq "" SLONG AION_auto_mode_request_CM_Beam_request__ 0 0 0 3 ECU_ADDRESS 0x00204350 /end MEASUREMENT
/begin MEASUREMENT AION_auto_mode_request_U.InBus_set_ADCU_info_set_BodyCtrlReq "" SLONG AION_auto_mode_request_CM_Enable_request__ 0 0 0 1 ECU_ADDRESS 0x00204354 /end MEASUREMENT
/begin MEASUREMENT AION_auto_mode_request_U.InBus_set_ADCU_info_set_Checksum1 "" ULONG AION_auto_mode_request_CM_uint32 0 0 0 255 ECU_ADDRESS 0x00204338 /end MEASUREMENT
/begin MEASUREMENT AION_auto_mode_request_U.InBus_set_ADCU_info_set_Checksum2 "" ULONG AION_auto_mode_request_CM_uint32 0 0 0 255 ECU_ADDRESS 0x00204340 /end MEASUREMENT
/begin MEASUREMENT AION_auto_mode_request_U.InBus_set_ADCU_info_set_Checksum3 "" ULONG AION_auto_mode_request_CM_uint32__ 0 0 0 255 ECU_ADDRESS 0x00204348 /end MEASUREMENT
/begin MEASUREMENT AION_auto_mode_request_U.InBus_set_ADCU_info_set_HornRingReq "" SLONG AION_auto_mode_request_CM_Active_request__ 0 0 0 1 ECU_ADDRESS 0x00204358 /end MEASUREMENT
/begin MEASUREMENT AION_auto_mode_request_U.InBus_set_ADCU_info_set_MsgCounter1 "" ULONG AION_auto_mode_request_CM_uint32 0 0 0 15 ECU_ADDRESS 0x0020433C /end MEASUREMENT
/begin MEASUREMENT AION_auto_mode_request_U.InBus_set_ADCU_info_set_MsgCounter2 "" ULONG AION_auto_mode_request_CM_uint32 0 0 0 15 ECU_ADDRESS 0x00204344 /end MEASUREMENT
/begin MEASUREMENT AION_auto_mode_request_U.InBus_set_ADCU_info_set_MsgCounter3 "" ULONG AION_auto_mode_request_CM_uint32__ 0 0 0 15 ECU_ADDRESS 0x0020434C /end MEASUREMENT
/begin MEASUREMENT AION_auto_mode_request_U.InBus_set_ADCU_info_set_TurnLightReq "" SLONG AION_auto_mode_request_CM_Light_request__ 0 0 0 3 ECU_ADDRESS 0x0020435C /end MEASUREMENT
/begin MEASUREMENT AION_auto_mode_request_U.InBus_set_SPK_info_set_Chk "" FLOAT64_IEEE AION_auto_mode_request_CM_double 0 0 -1.7E+308 1.7E+308 ECU_ADDRESS 0x00204388 /end MEASUREMENT
/begin MEASUREMENT AION_auto_mode_request_U.InBus_set_SPK_info_set_Etx "" FLOAT64_IEEE AION_auto_mode_request_CM_double 0 0 -1.7E+308 1.7E+308 ECU_ADDRESS 0x00204390 /end MEASUREMENT
/begin MEASUREMENT AION_auto_mode_request_U.InBus_set_SPK_info_set_FunctionCode "" FLOAT64_IEEE AION_auto_mode_request_CM_double 0 0 -1.7E+308 1.7E+308 ECU_ADDRESS 0x00204368 /end MEASUREMENT
/begin MEASUREMENT AION_auto_mode_request_U.InBus_set_SPK_info_set_Parameter "" FLOAT64_IEEE AION_auto_mode_request_CM_double 0 0 -1.7E+308 1.7E+308 ECU_ADDRESS 0x00204380 /end MEASUREMENT
/begin MEASUREMENT AION_auto_mode_request_U.InBus_set_SPK_info_set_SoundSourceCode "" FLOAT64_IEEE AION_auto_mode_request_CM_double 0 0 -1.7E+308 1.7E+308 ECU_ADDRESS 0x00204370 /end MEASUREMENT
/begin MEASUREMENT AION_auto_mode_request_U.InBus_set_SPK_info_set_Stx "" FLOAT64_IEEE AION_auto_mode_request_CM_double 0 0 -1.7E+308 1.7E+308 ECU_ADDRESS 0x00204360 /end MEASUREMENT
/begin MEASUREMENT AION_auto_mode_request_U.InBus_set_SPK_info_set_VolumeCode "" FLOAT64_IEEE AION_auto_mode_request_CM_double 0 0 -1.7E+308 1.7E+308 ECU_ADDRESS 0x00204378 /end MEASUREMENT
/begin MEASUREMENT AION_auto_mode_request_U.InBus_set_lateral_control_info_set_LatCtrlReq "" SLONG AION_auto_mode_request_CM_Control_request 0 0 0 3 ECU_ADDRESS 0x00204300 /end MEASUREMENT
/begin MEASUREMENT AION_auto_mode_request_U.InBus_set_lateral_control_info_set_SteerAngReq "" FLOAT64_IEEE AION_auto_mode_request_CM_double 0 0 -1.7E+308 1.7E+308 ECU_ADDRESS 0x00204308 /end MEASUREMENT
/begin MEASUREMENT AION_auto_mode_request_U.InBus_set_lateral_control_info_set_SteerWhlTorqReq "" FLOAT64_IEEE AION_auto_mode_request_CM_double 0 0 -1.7E+308 1.7E+308 ECU_ADDRESS 0x00204310 /end MEASUREMENT
/begin MEASUREMENT AION_auto_mode_request_U.InBus_set_longitudinal_control_info_set_AutoTrqWhlReq "" FLOAT64_IEEE AION_auto_mode_request_CM_double 0 0 0 5000 ECU_ADDRESS 0x00204320 /end MEASUREMENT
/begin MEASUREMENT AION_auto_mode_request_U.InBus_set_longitudinal_control_info_set_BrakeReq "" FLOAT64_IEEE AION_auto_mode_request_CM_double 0 0 -16 16 ECU_ADDRESS 0x00204328 /end MEASUREMENT
/begin MEASUREMENT AION_auto_mode_request_U.InBus_set_longitudinal_control_info_set_GearLvlReq "" SLONG AION_auto_mode_request_CM_Gear_request 0 0 0 7 ECU_ADDRESS 0x00204330 /end MEASUREMENT
/begin MEASUREMENT AION_auto_mode_request_U.InBus_set_longitudinal_control_info_set_GearLvlReqVD "" SLONG AION_auto_mode_request_CM_Validation_status 0 0 0 1 ECU_ADDRESS 0x00204334 /end MEASUREMENT
/begin MEASUREMENT AION_auto_mode_request_U.InBus_set_longitudinal_control_info_set_LngCtrlReq "" SLONG AION_auto_mode_request_CM_Control_request 0 0 0 3 ECU_ADDRESS 0x00204318 /end MEASUREMENT
/begin MEASUREMENT AION_auto_mode_request_Y.OutBus_get_BCM_info_get_CtrlAvailable "" SLONG AION_auto_mode_request_CM_Available_status 0 0 0 1 ECU_ADDRESS 0x00204258 /end MEASUREMENT
/begin MEASUREMENT AION_auto_mode_request_Y.OutBus_get_BCM_info_get_HazardLampSt "" SLONG AION_auto_mode_request_CM_Active_status 0 0 0 1 ECU_ADDRESS 0x0020425C /end MEASUREMENT
/begin MEASUREMENT AION_auto_mode_request_Y.OutBus_get_BCM_info_get_HighBeamSt "" SLONG AION_auto_mode_request_CM_Active_status 0 0 0 1 ECU_ADDRESS 0x00204260 /end MEASUREMENT
/begin MEASUREMENT AION_auto_mode_request_Y.OutBus_get_BCM_info_get_HornSt "" SLONG AION_auto_mode_request_CM_Active_status 0 0 0 1 ECU_ADDRESS 0x00204264 /end MEASUREMENT
/begin MEASUREMENT AION_auto_mode_request_Y.OutBus_get_BCM_info_get_KeySt "" UBYTE AION_auto_mode_request_CM_uint8 0 0 0 3 ECU_ADDRESS 0x00204268 /end MEASUREMENT
/begin MEASUREMENT AION_auto_mode_request_Y.OutBus_get_BCM_info_get_LeftTurnLampSt "" SLONG AION_auto_mode_request_CM_Active_status 0 0 0 1 ECU_ADDRESS 0x0020426C /end MEASUREMENT
/begin MEASUREMENT AION_auto_mode_request_Y.OutBus_get_BCM_info_get_LowBeamSt "" SLONG AION_auto_mode_request_CM_Active_status 0 0 0 1 ECU_ADDRESS 0x00204270 /end MEASUREMENT
/begin MEASUREMENT AION_auto_mode_request_Y.OutBus_get_BCM_info_get_RightTurnLampSt "" SLONG AION_auto_mode_request_CM_Active_status 0 0 0 1 ECU_ADDRESS 0x00204274 /end MEASUREMENT
/begin MEASUREMENT AION_auto_mode_request_Y.OutBus_get_BCS_info_get_ABSActiveSt "" UBYTE AION_auto_mode_request_CM_uint8__ 0 0 0 1 ECU_ADDRESS 0x002041B8 /end MEASUREMENT
/begin MEASUREMENT AION_auto_mode_request_Y.OutBus_get_BCS_info_get_ActVehLaltrlAccel "" FLOAT64_IEEE AION_auto_mode_request_CM_double_m_s_2 0 0 -21.593 21.593 ECU_ADDRESS 0x002041D8 /end MEASUREMENT
/begin MEASUREMENT AION_auto_mode_request_Y.OutBus_get_BCS_info_get_ActVehLongAccel "" FLOAT64_IEEE AION_auto_mode_request_CM_double_m_s_2 0 0 -21.593 21.593 ECU_ADDRESS 0x002041E0 /end MEASUREMENT
/begin MEASUREMENT AION_auto_mode_request_Y.OutBus_get_BCS_info_get_VehSpd "" FLOAT64_IEEE AION_auto_mode_request_CM_double_km_h 0 0 0 240 ECU_ADDRESS 0x002041C0 /end MEASUREMENT
/begin MEASUREMENT AION_auto_mode_request_Y.OutBus_get_BCS_info_get_VehSpdVD "" UBYTE AION_auto_mode_request_CM_uint8__ 0 0 0 1 ECU_ADDRESS 0x002041C8 /end MEASUREMENT
/begin MEASUREMENT AION_auto_mode_request_Y.OutBus_get_BCS_info_get_YawRate "" FLOAT64_IEEE AION_auto_mode_request_CM_double_rad_s 0 0 -2.0943 1.9047234375 ECU_ADDRESS 0x002041D0 /end MEASUREMENT
/begin MEASUREMENT AION_auto_mode_request_Y.OutBus_get_EPB_info_get_SysSt "" UBYTE AION_auto_mode_request_CM_uint8 0 0 0 7 ECU_ADDRESS 0x00204239 /end MEASUREMENT
/begin MEASUREMENT AION_auto_mode_request_Y.OutBus_get_EPS_info_get_SteeringAngle "" FLOAT64_IEEE AION_auto_mode_request_CM_double_deg 0 0 -780 779.9 ECU_ADDRESS 0x00204240 /end MEASUREMENT
/begin MEASUREMENT AION_auto_mode_request_Y.OutBus_get_EPS_info_get_SteeringAngleSpd "" ULONG AION_auto_mode_request_CM_uint32_deg_sec 0 0 0 1016 ECU_ADDRESS 0x00204248 /end MEASUREMENT
/begin MEASUREMENT AION_auto_mode_request_Y.OutBus_get_EPS_info_get_SteeringAngleSpdVD "" UBYTE AION_auto_mode_request_CM_uint8 0 0 0 1 ECU_ADDRESS 0x0020424C /end MEASUREMENT
/begin MEASUREMENT AION_auto_mode_request_Y.OutBus_get_EPS_info_get_SteeringAngleVD "" UBYTE AION_auto_mode_request_CM_uint8 0 0 0 1 ECU_ADDRESS 0x0020424D /end MEASUREMENT
/begin MEASUREMENT AION_auto_mode_request_Y.OutBus_get_EPS_info_get_StrngWhlTorq "" FLOAT64_IEEE AION_auto_mode_request_CM_double_Nm 0 0 -12.5 12.5 ECU_ADDRESS 0x00204250 /end MEASUREMENT
/begin MEASUREMENT AION_auto_mode_request_Y.OutBus_get_IMU_info_get_AccelerationX "" FLOAT64_IEEE AION_auto_mode_request_CM_double_g 0 0 -10 10 ECU_ADDRESS 0x002042C0 /end MEASUREMENT
/begin MEASUREMENT AION_auto_mode_request_Y.OutBus_get_IMU_info_get_AccelerationY "" FLOAT64_IEEE AION_auto_mode_request_CM_double_g 0 0 -10 10 ECU_ADDRESS 0x002042C8 /end MEASUREMENT
/begin MEASUREMENT AION_auto_mode_request_Y.OutBus_get_IMU_info_get_AccelerationZ "" FLOAT64_IEEE AION_auto_mode_request_CM_double_g 0 0 -10 10 ECU_ADDRESS 0x002042D0 /end MEASUREMENT
/begin MEASUREMENT AION_auto_mode_request_Y.OutBus_get_IMU_info_get_Altitude "" FLOAT64_IEEE AION_auto_mode_request_CM_double_m 0 0 -200 8000 ECU_ADDRESS 0x002042E8 /end MEASUREMENT
/begin MEASUREMENT AION_auto_mode_request_Y.OutBus_get_IMU_info_get_AngleSpeedX "" FLOAT64_IEEE AION_auto_mode_request_CM_double___s 0 0 -360 360 ECU_ADDRESS 0x002042A8 /end MEASUREMENT
/begin MEASUREMENT AION_auto_mode_request_Y.OutBus_get_IMU_info_get_AngleSpeedY "" FLOAT64_IEEE AION_auto_mode_request_CM_double___s 0 0 -360 360 ECU_ADDRESS 0x002042B0 /end MEASUREMENT
/begin MEASUREMENT AION_auto_mode_request_Y.OutBus_get_IMU_info_get_AngleSpeedZ "" FLOAT64_IEEE AION_auto_mode_request_CM_double___s 0 0 -360 360 ECU_ADDRESS 0x002042B8 /end MEASUREMENT
/begin MEASUREMENT AION_auto_mode_request_Y.OutBus_get_IMU_info_get_GPSTime "" FLOAT64_IEEE AION_auto_mode_request_CM_double_s 0 0 0 [] ECU_ADDRESS 0x00204280 /end MEASUREMENT
/begin MEASUREMENT AION_auto_mode_request_Y.OutBus_get_IMU_info_get_GPSWeek "" FLOAT64_IEEE AION_auto_mode_request_CM_double 0 0 -1.7E+308 1.7E+308 ECU_ADDRESS 0x00204278 /end MEASUREMENT
/begin MEASUREMENT AION_auto_mode_request_Y.OutBus_get_IMU_info_get_Heading "" FLOAT64_IEEE AION_auto_mode_request_CM_double__ 0 0 0 359.99 ECU_ADDRESS 0x00204288 /end MEASUREMENT
/begin MEASUREMENT AION_auto_mode_request_Y.OutBus_get_IMU_info_get_IMUWorkStatus "" SLONG AION_auto_mode_request_CM_IMU_Status 0 0 0 91 ECU_ADDRESS 0x002042A0 /end MEASUREMENT
/begin MEASUREMENT AION_auto_mode_request_Y.OutBus_get_IMU_info_get_Latitude "" FLOAT64_IEEE AION_auto_mode_request_CM_double__ 0 0 -90 90 ECU_ADDRESS 0x002042D8 /end MEASUREMENT
/begin MEASUREMENT AION_auto_mode_request_Y.OutBus_get_IMU_info_get_Longitude "" FLOAT64_IEEE AION_auto_mode_request_CM_double__ 0 0 -180 180 ECU_ADDRESS 0x002042E0 /end MEASUREMENT
/begin MEASUREMENT AION_auto_mode_request_Y.OutBus_get_IMU_info_get_Pitch "" FLOAT64_IEEE AION_auto_mode_request_CM_double__ 0 0 -90 90 ECU_ADDRESS 0x00204290 /end MEASUREMENT
/begin MEASUREMENT AION_auto_mode_request_Y.OutBus_get_IMU_info_get_Roll "" FLOAT64_IEEE AION_auto_mode_request_CM_double__ 0 0 -180 180 ECU_ADDRESS 0x00204298 /end MEASUREMENT
/begin MEASUREMENT AION_auto_mode_request_Y.OutBus_get_SCU_info_get_LatAutoCheckReport "" ULONG AION_auto_mode_request_CM_uint32 0 0 0 15 ECU_ADDRESS 0x00204220 /end MEASUREMENT
/begin MEASUREMENT AION_auto_mode_request_Y.OutBus_get_SCU_info_get_LatCtrlMode "" SLONG AION_auto_mode_request_CM_Control_status 0 0 0 3 ECU_ADDRESS 0x00204224 /end MEASUREMENT
/begin MEASUREMENT AION_auto_mode_request_Y.OutBus_get_SCU_info_get_LatQuitReport "" ULONG AION_auto_mode_request_CM_uint32 0 0 0 255 ECU_ADDRESS 0x00204228 /end MEASUREMENT
/begin MEASUREMENT AION_auto_mode_request_Y.OutBus_get_SCU_info_get_LngAutoCheckIReport "" ULONG AION_auto_mode_request_CM_uint32 0 0 0 65535 ECU_ADDRESS 0x0020422C /end MEASUREMENT
/begin MEASUREMENT AION_auto_mode_request_Y.OutBus_get_SCU_info_get_LngCtrlMode "" SLONG AION_auto_mode_request_CM_Control_status 0 0 0 3 ECU_ADDRESS 0x00204230 /end MEASUREMENT
/begin MEASUREMENT AION_auto_mode_request_Y.OutBus_get_SCU_info_get_LngQuitReport "" ULONG AION_auto_mode_request_CM_uint32 0 0 0 65535 ECU_ADDRESS 0x00204234 /end MEASUREMENT
/begin MEASUREMENT AION_auto_mode_request_Y.OutBus_get_SCU_info_get_StrngWhlIntv "" UBYTE AION_auto_mode_request_CM_uint8 0 0 0 1 ECU_ADDRESS 0x00204238 /end MEASUREMENT
/begin MEASUREMENT AION_auto_mode_request_Y.OutBus_get_SRS_info_get_DriverSeatBeltSt "" UBYTE AION_auto_mode_request_CM_uint8 0 0 0 3 ECU_ADDRESS 0x0020423A /end MEASUREMENT
/begin MEASUREMENT AION_auto_mode_request_Y.OutBus_get_SRS_info_get_PsngrSeatBeltSt "" UBYTE AION_auto_mode_request_CM_uint8 0 0 0 3 ECU_ADDRESS 0x0020423B /end MEASUREMENT
/begin MEASUREMENT AION_auto_mode_request_Y.OutBus_get_VCU_info_get_ACCButtInfo "" ULONG AION_auto_mode_request_CM_uint32 0 0 0 255 ECU_ADDRESS 0x0020421C /end MEASUREMENT
/begin MEASUREMENT AION_auto_mode_request_Y.OutBus_get_VCU_info_get_AccElecECFail "" UBYTE AION_auto_mode_request_CM_uint8__ 0 0 0 1 ECU_ADDRESS 0x00204210 /end MEASUREMENT
/begin MEASUREMENT AION_auto_mode_request_Y.OutBus_get_VCU_info_get_ActVehWheelTorq "" ULONG AION_auto_mode_request_CM_uint32_Nm 0 0 0 10000 ECU_ADDRESS 0x002041E8 /end MEASUREMENT
/begin MEASUREMENT AION_auto_mode_request_Y.OutBus_get_VCU_info_get_BrkPedalSt "" UBYTE AION_auto_mode_request_CM_uint8 0 0 0 1 ECU_ADDRESS 0x00204218 /end MEASUREMENT
/begin MEASUREMENT AION_auto_mode_request_Y.OutBus_get_VCU_info_get_CrntGearLvl "" SLONG AION_auto_mode_request_CM_Gear_status 0 0 0 4 ECU_ADDRESS 0x002041FC /end MEASUREMENT
/begin MEASUREMENT AION_auto_mode_request_Y.OutBus_get_VCU_info_get_CrntGearLvlVD "" UBYTE AION_auto_mode_request_CM_uint8 0 0 0 1 ECU_ADDRESS 0x00204200 /end MEASUREMENT
/begin MEASUREMENT AION_auto_mode_request_Y.OutBus_get_VCU_info_get_GasPedalActPst "" FLOAT64_IEEE AION_auto_mode_request_CM_double 0 0 0 100 ECU_ADDRESS 0x00204208 /end MEASUREMENT
/begin MEASUREMENT AION_auto_mode_request_Y.OutBus_get_VCU_info_get_GearLeverIntv "" UBYTE AION_auto_mode_request_CM_uint8 0 0 0 1 ECU_ADDRESS 0x002041EC /end MEASUREMENT
/begin MEASUREMENT AION_auto_mode_request_Y.OutBus_get_VCU_info_get_VehDrvMod "" SLONG AION_auto_mode_request_CM_Drive_status__ 0 0 0 5 ECU_ADDRESS 0x002041F0 /end MEASUREMENT
/begin MEASUREMENT AION_auto_mode_request_Y.OutBus_get_VCU_info_get_VehRdySt "" SLONG AION_auto_mode_request_CM_Ready_status__ 0 0 0 1 ECU_ADDRESS 0x002041F4 /end MEASUREMENT
/begin MEASUREMENT AION_auto_mode_request_Y.OutBus_get_VCU_info_get_VehRng "" ULONG AION_auto_mode_request_CM_uint32_km 0 0 0 1000 ECU_ADDRESS 0x002041F8 /end MEASUREMENT
/begin MEASUREMENT AION_auto_mode_request_Y.OutBus_get_VCU_info_get_VehWheelTorqMax "" ULONG AION_auto_mode_request_CM_uint32_Nm 0 0 0 10000 ECU_ADDRESS 0x00204214 /end MEASUREMENT
/begin MEASUREMENT AION_auto_mode_request_Y.OutBus_set_ADCU_info_set_BeamReq "" SLONG AION_auto_mode_request_CM_Beam_request__ 0 0 0 3 ECU_ADDRESS 0x00204170 /end MEASUREMENT
/begin MEASUREMENT AION_auto_mode_request_Y.OutBus_set_ADCU_info_set_BodyCtrlReq "" SLONG AION_auto_mode_request_CM_Enable_request__ 0 0 0 1 ECU_ADDRESS 0x00204174 /end MEASUREMENT
/begin MEASUREMENT AION_auto_mode_request_Y.OutBus_set_ADCU_info_set_Checksum1 "" ULONG AION_auto_mode_request_CM_uint32 0 0 0 255 ECU_ADDRESS 0x00204158 /end MEASUREMENT
/begin MEASUREMENT AION_auto_mode_request_Y.OutBus_set_ADCU_info_set_Checksum2 "" ULONG AION_auto_mode_request_CM_uint32 0 0 0 255 ECU_ADDRESS 0x00204160 /end MEASUREMENT
/begin MEASUREMENT AION_auto_mode_request_Y.OutBus_set_ADCU_info_set_Checksum3 "" ULONG AION_auto_mode_request_CM_uint32__ 0 0 0 255 ECU_ADDRESS 0x00204168 /end MEASUREMENT
/begin MEASUREMENT AION_auto_mode_request_Y.OutBus_set_ADCU_info_set_HornRingReq "" SLONG AION_auto_mode_request_CM_Active_request__ 0 0 0 1 ECU_ADDRESS 0x00204178 /end MEASUREMENT
/begin MEASUREMENT AION_auto_mode_request_Y.OutBus_set_ADCU_info_set_MsgCounter1 "" ULONG AION_auto_mode_request_CM_uint32 0 0 0 15 ECU_ADDRESS 0x0020415C /end MEASUREMENT
/begin MEASUREMENT AION_auto_mode_request_Y.OutBus_set_ADCU_info_set_MsgCounter2 "" ULONG AION_auto_mode_request_CM_uint32 0 0 0 15 ECU_ADDRESS 0x00204164 /end MEASUREMENT
/begin MEASUREMENT AION_auto_mode_request_Y.OutBus_set_ADCU_info_set_MsgCounter3 "" ULONG AION_auto_mode_request_CM_uint32__ 0 0 0 15 ECU_ADDRESS 0x0020416C /end MEASUREMENT
/begin MEASUREMENT AION_auto_mode_request_Y.OutBus_set_ADCU_info_set_TurnLightReq "" SLONG AION_auto_mode_request_CM_Light_request__ 0 0 0 3 ECU_ADDRESS 0x0020417C /end MEASUREMENT
/begin MEASUREMENT AION_auto_mode_request_Y.OutBus_set_SPK_info_set_Chk "" FLOAT64_IEEE AION_auto_mode_request_CM_double 0 0 -1.7E+308 1.7E+308 ECU_ADDRESS 0x002041A8 /end MEASUREMENT
/begin MEASUREMENT AION_auto_mode_request_Y.OutBus_set_SPK_info_set_Etx "" FLOAT64_IEEE AION_auto_mode_request_CM_double 0 0 -1.7E+308 1.7E+308 ECU_ADDRESS 0x002041B0 /end MEASUREMENT
/begin MEASUREMENT AION_auto_mode_request_Y.OutBus_set_SPK_info_set_FunctionCode "" FLOAT64_IEEE AION_auto_mode_request_CM_double 0 0 -1.7E+308 1.7E+308 ECU_ADDRESS 0x00204188 /end MEASUREMENT
/begin MEASUREMENT AION_auto_mode_request_Y.OutBus_set_SPK_info_set_Parameter "" FLOAT64_IEEE AION_auto_mode_request_CM_double 0 0 -1.7E+308 1.7E+308 ECU_ADDRESS 0x002041A0 /end MEASUREMENT
/begin MEASUREMENT AION_auto_mode_request_Y.OutBus_set_SPK_info_set_SoundSourceCode "" FLOAT64_IEEE AION_auto_mode_request_CM_double 0 0 -1.7E+308 1.7E+308 ECU_ADDRESS 0x00204190 /end MEASUREMENT
/begin MEASUREMENT AION_auto_mode_request_Y.OutBus_set_SPK_info_set_Stx "" FLOAT64_IEEE AION_auto_mode_request_CM_double 0 0 -1.7E+308 1.7E+308 ECU_ADDRESS 0x00204180 /end MEASUREMENT
/begin MEASUREMENT AION_auto_mode_request_Y.OutBus_set_SPK_info_set_VolumeCode "" FLOAT64_IEEE AION_auto_mode_request_CM_double 0 0 -1.7E+308 1.7E+308 ECU_ADDRESS 0x00204198 /end MEASUREMENT
/begin MEASUREMENT AION_auto_mode_request_Y.OutBus_set_lateral_control_info_set_LatCtrlReq "" SLONG AION_auto_mode_request_CM_Control_request 0 0 0 3 ECU_ADDRESS 0x00204120 /end MEASUREMENT
/begin MEASUREMENT AION_auto_mode_request_Y.OutBus_set_lateral_control_info_set_SteerAngReq "" FLOAT64_IEEE AION_auto_mode_request_CM_double 0 0 -1.7E+308 1.7E+308 ECU_ADDRESS 0x00204128 /end MEASUREMENT
/begin MEASUREMENT AION_auto_mode_request_Y.OutBus_set_lateral_control_info_set_SteerWhlTorqReq "" FLOAT64_IEEE AION_auto_mode_request_CM_double 0 0 -1.7E+308 1.7E+308 ECU_ADDRESS 0x00204130 /end MEASUREMENT
/begin MEASUREMENT AION_auto_mode_request_Y.OutBus_set_longitudinal_control_info_set_AutoTrqWhlReq "" FLOAT64_IEEE AION_auto_mode_request_CM_double 0 0 0 5000 ECU_ADDRESS 0x00204140 /end MEASUREMENT
/begin MEASUREMENT AION_auto_mode_request_Y.OutBus_set_longitudinal_control_info_set_BrakeReq "" FLOAT64_IEEE AION_auto_mode_request_CM_double 0 0 -16 16 ECU_ADDRESS 0x00204148 /end MEASUREMENT
/begin MEASUREMENT AION_auto_mode_request_Y.OutBus_set_longitudinal_control_info_set_GearLvlReq "" SLONG AION_auto_mode_request_CM_Gear_request 0 0 0 7 ECU_ADDRESS 0x00204150 /end MEASUREMENT
/begin MEASUREMENT AION_auto_mode_request_Y.OutBus_set_longitudinal_control_info_set_GearLvlReqVD "" SLONG AION_auto_mode_request_CM_Validation_status 0 0 0 1 ECU_ADDRESS 0x00204154 /end MEASUREMENT
/begin MEASUREMENT AION_auto_mode_request_Y.OutBus_set_longitudinal_control_info_set_LngCtrlReq "" SLONG AION_auto_mode_request_CM_Control_request 0 0 0 3 ECU_ADDRESS 0x00204138 /end MEASUREMENT
/begin COMPU_METHOD AION_auto_mode_request_CM_Active_request__ "" TAB_VERB "%0.6" "-" COMPU_TAB_REF VTAB_FOR_AION_auto_mode_request_CM_Active_request__ /end COMPU_METHOD
/begin COMPU_VTAB VTAB_FOR_AION_auto_mode_request_CM_Active_request__ "Enumerated data type: Active_request" TAB_VERB 2 0 "NotActiveRequest" 1 "ActiveRequest" /end COMPU_VTAB
/begin COMPU_METHOD AION_auto_mode_request_CM_Active_status "" TAB_VERB "%0.6" "" COMPU_TAB_REF VTAB_FOR_AION_auto_mode_request_CM_Active_status /end COMPU_METHOD
/begin COMPU_VTAB VTAB_FOR_AION_auto_mode_request_CM_Active_status "Enumerated data type: Active_status" TAB_VERB 2 0 "NotActiveStatus" 1 "ActiveStatus" /end COMPU_VTAB
/begin COMPU_METHOD AION_auto_mode_request_CM_Available_status "" TAB_VERB "%0.6" "" COMPU_TAB_REF VTAB_FOR_AION_auto_mode_request_CM_Available_status /end COMPU_METHOD
/begin COMPU_VTAB VTAB_FOR_AION_auto_mode_request_CM_Available_status "Enumerated data type: Available_status" TAB_VERB 2 0 "NotAvailable" 1 "Available" /end COMPU_VTAB
/begin COMPU_METHOD AION_auto_mode_request_CM_Beam_request__ "" TAB_VERB "%0.6" "-" COMPU_TAB_REF VTAB_FOR_AION_auto_mode_request_CM_Beam_request__ /end COMPU_METHOD
/begin COMPU_VTAB VTAB_FOR_AION_auto_mode_request_CM_Beam_request__ "Enumerated data type: Beam_request" TAB_VERB 4 0 "NoBeamRequest" 1 "LowBeam" 2 "HighBeam" 3 "BeamReserved" /end COMPU_VTAB
/begin COMPU_METHOD AION_auto_mode_request_CM_Control_request "" TAB_VERB "%0.6" "" COMPU_TAB_REF VTAB_FOR_AION_auto_mode_request_CM_Control_request /end COMPU_METHOD
/begin COMPU_VTAB VTAB_FOR_AION_auto_mode_request_CM_Control_request "Enumerated data type: Control_request" TAB_VERB 4 0 "Manual" 1 "Auto" 2 "Reserved" 3 "Reserved1" /end COMPU_VTAB
/begin COMPU_METHOD AION_auto_mode_request_CM_Control_status "" TAB_VERB "%0.6" "" COMPU_TAB_REF VTAB_FOR_AION_auto_mode_request_CM_Control_status /end COMPU_METHOD
/begin COMPU_VTAB VTAB_FOR_AION_auto_mode_request_CM_Control_status "Enumerated data type: Control_status" TAB_VERB 4 0 "ManualStatus" 1 "QuitStatus" 2 "AutoStatus" 3 "FaultStatus" /end COMPU_VTAB
/begin COMPU_METHOD AION_auto_mode_request_CM_Drive_status__ "" TAB_VERB "%0.6" "-" COMPU_TAB_REF VTAB_FOR_AION_auto_mode_request_CM_Drive_status__ /end COMPU_METHOD
/begin COMPU_VTAB VTAB_FOR_AION_auto_mode_request_CM_Drive_status__ "Enumerated data type: Drive_status" TAB_VERB 6 0 "InvalidDriveStatus" 1 "EcoPlusModeStatus" 2 "EcoModeStatus" 3 "NormalModeStatus" 4 "DrivingModeStatus" 5 "SportModeStatus" /end COMPU_VTAB
/begin COMPU_METHOD AION_auto_mode_request_CM_Enable_request__ "" TAB_VERB "%0.6" "-" COMPU_TAB_REF VTAB_FOR_AION_auto_mode_request_CM_Enable_request__ /end COMPU_METHOD
/begin COMPU_VTAB VTAB_FOR_AION_auto_mode_request_CM_Enable_request__ "Enumerated data type: Enable_request" TAB_VERB 2 0 "Disable" 1 "Enable" /end COMPU_VTAB
/begin COMPU_METHOD AION_auto_mode_request_CM_Gear_request "" TAB_VERB "%0.6" "" COMPU_TAB_REF VTAB_FOR_AION_auto_mode_request_CM_Gear_request /end COMPU_METHOD
/begin COMPU_VTAB VTAB_FOR_AION_auto_mode_request_CM_Gear_request "Enumerated data type: Gear_request" TAB_VERB 8 0 "NoRequest" 1 "P" 2 "R" 3 "N" 4 "D" 5 "Reserved_gear" 6 "Reserved1_gear" 7 "Reserved2_gear" /end COMPU_VTAB
/begin COMPU_METHOD AION_auto_mode_request_CM_Gear_status "" TAB_VERB "%0.6" "" COMPU_TAB_REF VTAB_FOR_AION_auto_mode_request_CM_Gear_status /end COMPU_METHOD
/begin COMPU_VTAB VTAB_FOR_AION_auto_mode_request_CM_Gear_status "Enumerated data type: Gear_status" TAB_VERB 5 0 "InvalidGearStatus" 1 "DriveGearStatus" 2 "NeutralGearStatus" 3 "ReverseGearStatus" 4 "ParkGearStatus" /end COMPU_VTAB
/begin COMPU_METHOD AION_auto_mode_request_CM_IMU_Status "" TAB_VERB "%0.6" "" COMPU_TAB_REF VTAB_FOR_AION_auto_mode_request_CM_IMU_Status /end COMPU_METHOD
/begin COMPU_VTAB VTAB_FOR_AION_auto_mode_request_CM_IMU_Status "Enumerated data type: IMU_Status" TAB_VERB 7 0 "Initialization" 3 "Single_Point_Location" 4 "Single_Point_Orientation" 69 "RTK_INT_Location" 75 "RTK_INT_Orientation" 85 "RTK_FLOAT_Location" 91 "RTK_FLOAT_Orientation" /end COMPU_VTAB
/begin COMPU_METHOD AION_auto_mode_request_CM_Light_request__ "" TAB_VERB "%0.6" "-" COMPU_TAB_REF VTAB_FOR_AION_auto_mode_request_CM_Light_request__ /end COMPU_METHOD
/begin COMPU_VTAB VTAB_FOR_AION_auto_mode_request_CM_Light_request__ "Enumerated data type: Light_request" TAB_VERB 4 0 "NoLightRequest" 1 "TurnLeftLight" 2 "TurnRightLight" 3 "EmergencyLight" /end COMPU_VTAB
/begin COMPU_METHOD AION_auto_mode_request_CM_Ready_status__ "" TAB_VERB "%0.6" "-" COMPU_TAB_REF VTAB_FOR_AION_auto_mode_request_CM_Ready_status__ /end COMPU_METHOD
/begin COMPU_VTAB VTAB_FOR_AION_auto_mode_request_CM_Ready_status__ "Enumerated data type: Ready_status" TAB_VERB 2 0 "NotReady" 1 "Ready" /end COMPU_VTAB
/begin COMPU_METHOD AION_auto_mode_request_CM_Validation_status "" TAB_VERB "%0.6" "" COMPU_TAB_REF VTAB_FOR_AION_auto_mode_request_CM_Validation_status /end COMPU_METHOD
/begin COMPU_VTAB VTAB_FOR_AION_auto_mode_request_CM_Validation_status "Enumerated data type: Validation_status" TAB_VERB 2 0 "Invalid" 1 "Valid" /end COMPU_VTAB
/begin COMPU_METHOD AION_auto_mode_request_CM_double "" IDENTICAL "%15.10" "" /end COMPU_METHOD
/begin COMPU_METHOD AION_auto_mode_request_CM_double_Nm "" IDENTICAL "%15.10" "Nm" /end COMPU_METHOD
/begin COMPU_METHOD AION_auto_mode_request_CM_double__ "" IDENTICAL "%15.10" "°" /end COMPU_METHOD
/begin COMPU_METHOD AION_auto_mode_request_CM_double___s "" IDENTICAL "%15.10" "°/s" /end COMPU_METHOD
/begin COMPU_METHOD AION_auto_mode_request_CM_double_deg "" IDENTICAL "%15.10" "deg" /end COMPU_METHOD
/begin COMPU_METHOD AION_auto_mode_request_CM_double_g "" IDENTICAL "%15.10" "g" /end COMPU_METHOD
/begin COMPU_METHOD AION_auto_mode_request_CM_double_km_h "" IDENTICAL "%15.10" "km/h" /end COMPU_METHOD
/begin COMPU_METHOD AION_auto_mode_request_CM_double_m "" IDENTICAL "%15.10" "m" /end COMPU_METHOD
/begin COMPU_METHOD AION_auto_mode_request_CM_double_m_s_2 "" IDENTICAL "%15.10" "m/s^2" /end COMPU_METHOD
/begin COMPU_METHOD AION_auto_mode_request_CM_double_rad_s "" IDENTICAL "%15.10" "rad/s" /end COMPU_METHOD
/begin COMPU_METHOD AION_auto_mode_request_CM_double_s "" IDENTICAL "%15.10" "s" /end COMPU_METHOD
/begin COMPU_METHOD AION_auto_mode_request_CM_int32 "" IDENTICAL "%10.0" "" /end COMPU_METHOD
/begin COMPU_METHOD AION_auto_mode_request_CM_uint32 "" IDENTICAL "%10.0" "" /end COMPU_METHOD
/begin COMPU_METHOD AION_auto_mode_request_CM_uint32_Nm "" IDENTICAL "%10.0" "Nm" /end COMPU_METHOD
/begin COMPU_METHOD AION_auto_mode_request_CM_uint32__ "" IDENTICAL "%10.0" "-" /end COMPU_METHOD
/begin COMPU_METHOD AION_auto_mode_request_CM_uint32_deg_sec "" IDENTICAL "%10.0" "deg/sec" /end COMPU_METHOD
/begin COMPU_METHOD AION_auto_mode_request_CM_uint32_km "" IDENTICAL "%10.0" "km" /end COMPU_METHOD
/begin COMPU_METHOD AION_auto_mode_request_CM_uint8 "" IDENTICAL "%3.0" "" /end COMPU_METHOD
/begin COMPU_METHOD AION_auto_mode_request_CM_uint8__ "" IDENTICAL "%3.0" "-" /end COMPU_METHOD
/begin RECORD_LAYOUT FixLookup_FLOAT64_IEEE FNC_VALUES 1 FLOAT64_IEEE COLUMN_DIR DIRECT /end RECORD_LAYOUT
/begin RECORD_LAYOUT Scalar_FLOAT64_IEEE FNC_VALUES 1 FLOAT64_IEEE COLUMN_DIR DIRECT /end RECORD_LAYOUT
/begin RECORD_LAYOUT Scalar_SLONG FNC_VALUES 1 SLONG COLUMN_DIR DIRECT /end RECORD_LAYOUT
/begin RECORD_LAYOUT Scalar_UBYTE FNC_VALUES 1 UBYTE COLUMN_DIR DIRECT /end RECORD_LAYOUT
/begin RECORD_LAYOUT Scalar_ULONG FNC_VALUES 1 ULONG COLUMN_DIR DIRECT /end RECORD_LAYOUT
/begin GROUP AION_auto_mode_request "AION_auto_mode_request" ROOT /end GROUP
/end MODULE
/end PROJECT
